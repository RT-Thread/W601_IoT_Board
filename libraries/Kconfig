## libraries/Kconfig
```kconfig
menu "External Libraries"
    menuconfig RT_USING_SMARTCONFIG_LIB
        bool "Using RT-Thrad SmartConfig Library"
        select RT_USING_WIFI
        default n

    if RT_USING_SMARTCONFIG_LIB
        config RT_USING_SMARTCONFIG_DEMO
            bool "Using SmartConfig Demo"
            default y
    endif

    menuconfig WM_USING_ONESHOT
        bool "Using winner micro Oneshot"
        select RT_USING_WIFI
        default n

    if WM_USING_ONESHOT
        config WM_USING_ONESHOT_DEMO
            bool "Using Oneshot Demo"
            default y
    endif

    menuconfig RT_USING_CLOUDSDK_LIB
        bool "Using RT-Thread CLOUDSDK Library"     
        select RT_USING_OTA_LIB
        select PKG_USING_CJSON
        select PKG_USING_EASYFLASH
        select PKG_USING_FAL
        select PKG_USING_PAHOMQTT
        select PKG_USING_TINYCRYPT
        select PKG_USING_WEBCLIENT  
        default n         
endmenu
```
