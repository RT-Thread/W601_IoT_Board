; *************************************************************
; *** Scatter-Loading Description File generated by uVision ***
; *************************************************************

LR_IROM1 0x08010100 0x000EFEFF  {    ; load region size_region
   ER_IROM1 0x08010100 0x000EFEFF  {  ; load address = execution address
   *.o (RESET, +First)
   *(InRoot$$Sections)
   .ANY (+RO)
   .ANY (+XO)
  }
  RW_IRAM1 0x20000000 0x00028000  {
   .ANY (+RW)
   .ANY (+ZI)
  }
  RW_IRAM2 0x20028000 0x00014000  { ; RW data
   memp.o (+ZI)
   wm_param.o (+ZI)
   wm_fwup.o (+ZI)
   tls_rf_tx_iq.o (+ZI)
   tx_lo_cal.o (+ZI)
   ef_env.o (+ZI)
   dns.o (+ZI)
   ; Other .bss data
   kservice.o (+ZI)
   mem.o (+ZI)
   scheduler.o (+ZI)
   ntp.o (+ZI)
   dfs.o (+ZI)
   dfs_file.o (+ZI)
   pin.o (+ZI)
   soft_rtc.o (+ZI)
   spi_flash_sfud.o (+ZI)
   sfud.o (+ZI)
   wlan_cfg.o (+ZI)
   wlan_lwip.o (+ZI)
   wlan_mgnt.o (+ZI)
   wlan_prot.o (+ZI)
   shell.o (+ZI)
   netdb.o (+ZI)
   sockets.o (+ZI)
   ip.o (+ZI)
   tcp_in.o (+ZI)
   dhcp.o (+ZI)
   etharp.o (+ZI)
   ip4_addr.o (+ZI)
   netdev_ipaddr.o (+ZI)
   sal_socket.o (+ZI)
   wm_gpio.o (+ZI)
   wm_irq.o (+ZI)
   wm_efuse.o (+ZI)
   wm_dma.o (+ZI)
   wm_timer.o (+ZI)
   wm_i2c.o (+ZI)
   wm_adc.o (+ZI)
   rtthread_patch.o (+ZI)
   drv_uart.o (+ZI)
   drv_wifi.o (+ZI)
   drv_spi.o (+ZI)
   smartconfig.o (+ZI)
   random.o (+ZI)
   tls_wl_util.o (+ZI)
   common.o (+ZI)
   stdio_streams.o (+ZI)
   rand.o (+ZI)
   localtime.o (+ZI)
   asctime.o (+ZI)
   libspace.o (+ZI)
  }
}
